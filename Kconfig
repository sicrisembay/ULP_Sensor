## Kconfig
```kconfig
menu "ULP Configuration"
  choice ULP_RTC_SDA
      prompt "ULP RTC SDA Pin"
      default ULP_RTC_SDA_IO_8
      config ULP_RTC_SDA_IO_8
          bool "RTC GPIO 8"
      config ULP_RTC_SDA_IO_9
          bool "RTC GPIO 9"
  endchoice
  config ULP_I2C_SDA_IO
    int
    default 8 if ULP_RTC_SDA_IO_8
    default 9 if ULP_RTC_SDA_IO_9
  config ESP32_I2C_SDA_IO
    int
    default 33 if ULP_RTC_SDA_IO_8
    default 32 if ULP_RTC_SDA_IO_9

  choice ULP_RTC_SCL
      prompt "ULP RTC SCL Pin"
      default ULP_RTC_SCL_IO_9
      config ULP_RTC_SCL_IO_8
          bool "RTC GPIO 8"
      config ULP_RTC_SCL_IO_9
          bool "RTC GPIO 9"
  endchoice
  config ULP_I2C_SCL_IO
    int
    default 8 if ULP_RTC_SCL_IO_8
    default 9 if ULP_RTC_SCL_IO_9
  config ESP32_I2C_SCL_IO
    int
    default 33 if ULP_RTC_SCL_IO_8
    default 32 if ULP_RTC_SCL_IO_9

  source "$(ULP_SENSOR_PATH)/ina219/Kconfig"

endmenu # "ULP Configuration"
```

## ina219/Kconfig
```kconfig
menu "INA219 Configuration"
    depends on ULP_SENSOR_INA219

    config ULP_INA219_DEVICE_COUNT
        int "Number of devices on the I2C bus"
        range 1 3
        default 1
    
    menu "INA219 DEV1 Configuration"
        depends on (ULP_INA219_DEVICE_COUNT >= 1)
        config ULP_INA219_ADDR_DEV1
            hex "I2C Address"
            default 0x40
        config ULP_INA219_MODE_DEV1
            int "Mode Setting"
            range 0 7
            default 7
        config ULP_INA219_SADC_DEV1
            int "Shunt ADC Setting"
            range 0 15
            default 14
        config ULP_INA219_BADC_DEV1
            int "Bus ADC Setting"
            range 0 15
            default 14
            
        config ULP_INA219_PGA_DEV1
            int "PGA Setting"
            range 0 3
            default 3
            help
                0 : Gain 1, +/-40mV Range
                1 : Gain /2, +/-80mV Range
                2 : Gain /4, +/-160mV Range
                3 : Gain /8, +/-320mV Range
        config ULP_INA219_BUS_DEV1
            int "Bus Voltage Range Setting"
            range 0 1
            default 0
            help
                0: 16V FSR, 1: 32V FSR
        config ULP_INA219_R_DEV1
            int "Shunt Resistance, milli-ohm"
            default 100
        config ULP_INA219_CAL_FS_DEV1
            int "Current/Power Calibration"
            range 0 65535
            default 953
    endmenu #"INA219 DEV1 Configuration"

    menu "INA219 DEV2 Configuration"
        depends on (ULP_INA219_DEVICE_COUNT >= 2)
        config ULP_INA219_ADDR_DEV2
            hex "I2C Address"
            default 0x41
        config ULP_INA219_MODE_DEV2
            int "Mode Setting"
            range 0 7
            default 7
        config ULP_INA219_SADC_DEV2
            int "Shunt ADC Setting"
            range 0 15
            default 14
        config ULP_INA219_BADC_DEV2
            int "Bus ADC Setting"
            range 0 15
            default 14
        config ULP_INA219_PGA_DEV2
            int "PGA Setting"
            range 0 3
            default 3
            help
                0 : Gain 1, +/-40mV Range
                1 : Gain /2, +/-80mV Range
                2 : Gain /4, +/-160mV Range
                3 : Gain /8, +/-320mV Range
        config ULP_INA219_BUS_DEV2
            int "Bus Voltage Range Setting"
            range 0 1
            default 0
            help
                0: 16V FSR, 1: 32V FSR
        config ULP_INA219_R_DEV2
            int "Shunt Resistance, milli-ohm"
            default 100
        config ULP_INA219_CAL_FS_DEV2
            int "Current/Power Calibration"
            range 0 65535
            default 953
    endmenu # "INA219 DEV2 Configuration"

    menu "INA219 DEV3 Configuration"
        depends on (ULP_INA219_DEVICE_COUNT >= 3)
        config ULP_INA219_ADDR_DEV3
            hex "I2C Address"
            default 0x44
        config ULP_INA219_MODE_DEV3
            int "Mode Setting"
            range 0 7
            default 7
        config ULP_INA219_SADC_DEV3
            int "Shunt ADC Setting"
            range 0 15
            default 14
        config ULP_INA219_BADC_DEV3
            int "Bus ADC Setting"
            range 0 15
            default 14
        config ULP_INA219_PGA_DEV3
            int "PGA Setting"
            range 0 3
            default 3
            help
                0 : Gain 1, +/-40mV Range
                1 : Gain /2, +/-80mV Range
                2 : Gain /4, +/-160mV Range
                3 : Gain /8, +/-320mV Range
        config ULP_INA219_BUS_DEV3
            int "Bus Voltage Range Setting"
            range 0 1
            default 0
            help
                0: 16V FSR, 1: 32V FSR
        config ULP_INA219_R_DEV3
            int "Shunt Resistance, milli-ohm"
            default 100
        config ULP_INA219_CAL_FS_DEV3
            int "Current/Power Calibration"
            range 0 65535
            default 953
    endmenu # "INA219 DEV3 Configuration"

endmenu #"INA219 Configuration"
```
